## Proyecto final/sdkconfig.defaults
```kconfig
CONFIG_IDF_TARGET="esp32s3"
CONFIG_ESPTOOLPY_FLASHSIZE_4MB=y
CONFIG_ESPTOOLPY_FLASHMODE_DIO=y
CONFIG_ESPTOOLPY_FLASHFREQ_40M=y
CONFIG_FREERTOS_UNICORE=y
CONFIG_ESP_TASK_WDT_CHECK_IDLE_TASK_CPU0=n
```
